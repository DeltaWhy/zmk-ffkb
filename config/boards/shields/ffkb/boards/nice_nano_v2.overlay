#include <dt-bindings/zmk/matrix_transform.h>

&spi1 {
    compatible = "nordic,nrf-spim";
    /* Cannot be used together with i2c0. */
    status = "okay";
    mosi-pin = <6>;
    // Unused pins, needed for SPI definition, but not used by the ws2812 driver itself.
    sck-pin = <5>;
    miso-pin = <7>;
    cs-gpios = <&pro_micro 10 GPIO_ACTIVE_LOW>;

    shift_reg: 595@0 {
        compatible = "zmk,gpio-595";
        status = "okay";
        gpio-controller;
        spi-max-frequency = <200000>;
        reg = <0>;
        label = "74HC595";
        #gpio-cells = <2>;
        ngpios = <8>;
    };

};

